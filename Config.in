## Config.in
```kconfig
source "$BR2_EXTERNAL_CUSTOM_RV32_PATH/package/memhog/Config.in"
source "$BR2_EXTERNAL_CUSTOM_RV32_PATH/package/tracemark/Config.in"
source "$BR2_EXTERNAL_CUSTOM_RV32_PATH/package/qemu-tracewin/Config.in.host"
```

## configs/custom_rv32_defconfig
```kconfig
BR2_riscv=y
BR2_RISCV_ISA_RVC=y
BR2_RISCV_32=y
# BR2_RISCV_USE_MMU is not set
BR2_PACKAGE_HOST_LINUX_HEADERS_CUSTOM_6_18=y
BR2_CCACHE=y
#BR2_TARGET_OPTIMIZATION="-march=rv32imafdc_zicsr_zifencei_zba_zbb_zbs -mabi=ilp32d"
BR2_ROOTFS_OVERLAY="$(BR2_EXTERNAL_CUSTOM_RV32_PATH)/board/custom_rv32/overlay"
BR2_ROOTFS_POST_IMAGE_SCRIPT="$(BR2_EXTERNAL_CUSTOM_RV32_PATH)/board/custom_rv32/post-image.sh"
BR2_LINUX_KERNEL=y
BR2_LINUX_KERNEL_CUSTOM_VERSION=y
BR2_LINUX_KERNEL_CUSTOM_VERSION_VALUE="6.18.7"
BR2_LINUX_KERNEL_DEFCONFIG="nommu_virt"
BR2_LINUX_KERNEL_CONFIG_FRAGMENT_FILES="$(BR2_EXTERNAL_CUSTOM_RV32_PATH)/board/custom_rv32/linux-nommu.fragment"
BR2_LINUX_KERNEL_VMLINUX=y
BR2_TARGET_ROOTFS_INITRAMFS=y
# BR2_TARGET_ROOTFS_TAR is not set
BR2_PACKAGE_HOST_QEMU=y
BR2_PACKAGE_HOST_QEMU_SYSTEM_MODE=y
BR2_PACKAGE_HOST_RISCV_ISA_SIM=y
```

## package/memhog/Config.in
```kconfig
config BR2_PACKAGE_MEMHOG
	bool "memhog"
	help
	  Allocates and touches memory to measure how much RAM user
	  programs can get on the no-MMU kernel: the largest single
	  (contiguous) block and the total in small blocks.

	  Source: src/memhog/ in the custom_rv32 external tree.
```

## package/qemu-tracewin/Config.in.host
```kconfig
config BR2_PACKAGE_HOST_QEMU_TRACEWIN
	bool "host qemu tracewin plugin"
	depends on BR2_PACKAGE_HOST_QEMU
	help
	  QEMU TCG plugin that logs instructions (and loads/stores,
	  optionally register writes) between the trace markers, at close
	  to full speed outside them. Installed as
	  $(HOST_DIR)/lib/qemu-plugins/libtracewin.so and used by
	  images/trace-qemu.sh.

	  See docs/tracing.md in the custom_rv32 external tree.
```

## package/tracemark/Config.in
```kconfig
config BR2_PACKAGE_TRACEMARK
	bool "tracemark"
	help
	  `tracemark on|off` executes a trace marker instruction, to
	  start or stop QEMU (tracewin plugin) and Spike
	  (SPIKE_TRACE_GATE) tracing. Also installs <trace_marker.h>
	  with TRACE_ON()/TRACE_OFF() for other packages.

	  See docs/tracing.md in the custom_rv32 external tree.
```
